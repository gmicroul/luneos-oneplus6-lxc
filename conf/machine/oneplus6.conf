## conf/machine/oneplus6.conf
```bitbake
#@TYPE: Machine
#@NAME: OnePlus 6 (enchilada)
#@DESCRIPTION: Machine configuration for OnePlus 6

require conf/machine/include/arm/arch-arm64.inc

MACHINE_ARCH = "aarch64"

# Kernel
PREFERRED_PROVIDER_virtual/kernel = "linux-oneplus6"
KERNEL_IMAGETYPE = "Image.gz-dtb"

# Bootloader
PREFERRED_PROVIDER_virtual/bootloader = "u-boot"

# Hardware features
MACHINE_FEATURES = "apm alsa bluetooth wifi gpu"

# Serial console
SERIAL_CONSOLES = "115200;ttyMSM0"

# Device-specific overrides
MACHINEOVERRIDES =. "oneplus6:"
```
